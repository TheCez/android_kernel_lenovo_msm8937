/*
 * Copyright (c) 2015-2016, The Linux Foundation. All rights reserved.
 *
 * This program is free software; you can redistribute it and/or modify
 * it under the terms of the GNU General Public License version 2 and
 * only version 2 as published by the Free Software Foundation.
 *
 * This program is distributed in the hope that it will be useful,
 * but WITHOUT ANY WARRANTY; without even the implied warranty of
 * MERCHANTABILITY or FITNESS FOR A PARTICULAR PURPOSE.  See the
 * GNU General Public License for more details.
 */

#include "../msm8937-pinctrl.dtsi"

&soc {
	tlmm: pinctrl@1000000 {
		i2c_8 {
			/* active state */
			i2c_8_active: i2c_8_active{
				mux {
					/* CLK, DATA */
					pins = "gpio98", "gpio99";
					function = "blsp_i2c8";
				};

				config {
					pins = "gpio98", "gpio99";
					drive-strength = <2>; /* 2 MA */
					bias-disable; /* No PULL */
				};
			};

			/* suspended state */
			i2c_8_sleep: i2c_8_sleep {
				mux {
					/* CLK, DATA */
					pins = "gpio98", "gpio99";
					function = "blsp_i2c8";
				};

				config {
					pins = "gpio98", "gpio99";
					drive-strength = <2>; /* 2 MA */
					bias-disable; /* No PULL */
				};
			};
		};

		pmx_adv7533_int: pmx_adv7533_int {
			adv7533_int_active: adv7533_int_active {
				mux {
					pins = "gpio128";
					function = "gpio";
				};

				config {
					pins = "gpio128";
					drive-strength = <16>;
					bias-disable;
				};
			};

			adv7533_int_suspend: adv7533_int_suspend {
				mux {
					pins = "gpio128";
					function = "gpio";
				};

				config {
					pins = "gpio128";
					drive-strength = <16>;
					bias-disable;
				};
			};

		};


			mdss_dsi_suspend: mdss_dsi_suspend {
				mux {
					pins = "gpio60", "gpio98", "gpio99";
                                        function = "gpio";
				};

				config {
					pins = "gpio60", "gpio98", "gpio99";
                                        drive-strength = <8>; /* 8 mA */
                                        bias-disable = <0>; /* no pull */
                                        output-high;
				};
			};
		};

		/* add pingrp for touchscreen */
		pmx_ts_int_active {
			ts_int_active: ts_int_active {
				mux {
					pins = "gpio65";
					function = "gpio";
				};

				config {
					pins = "gpio65";
					drive-strength = <8>;
					bias-no-pull;
				};
			};
		};

		pmx_ts_reset_active {
			ts_reset_active: ts_reset_active {
				mux {
					pins = "gpio64";
					function = "gpio";
				};

				config {
					pins = "gpio64";
					drive-strength = <8>;
					bias-no-pull;
					output-low;
				};
			};
		};

		pmx_ts_reset_suspend {
			ts_reset_suspend: ts_reset_suspend {
				mux {
					pins = "gpio64";
					function = "gpio";
				};

				config {
					pins = "gpio64";
					drive-strength = <2>;
					bias-no-pull;
					output-low;
				};
			};
		};

		sdhc2_cd_pin {
			sdc2_cd_on: cd_on {
				mux {
					pins = "gpio67";
					function = "gpio";
				};

				config {
					pins = "gpio67";
					drive-strength = <2>;
					bias-pull-up; /* pull up */
					input-enable;
				};
			};

			sdc2_cd_off: cd_off {
				mux {
					pins = "gpio67";
					function = "gpio";
				};

				config {
					pins = "gpio67";
					drive-strength = <2>;
					bias-pull-up; /* pull up */
					input-enable;
				};
			};
		};
